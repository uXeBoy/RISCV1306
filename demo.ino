/**************************************************************************
 This is an example for our Monochrome OLEDs based on SSD1306 drivers

 Pick one up today in the adafruit shop!
 ------> http://www.adafruit.com/category/63_98

 This example is for a 128x64 pixel display using SPI to communicate
 4 or 5 pins are required to interface.

 Adafruit invests time and resources providing this open
 source code, please support Adafruit and open-source
 hardware by purchasing products from Adafruit!

 Written by Limor Fried/Ladyada for Adafruit Industries,
 with contributions from the open source community.
 BSD license, check license.txt for more information
 All text above, and the splash screen below must be
 included in any redistribution.
 **************************************************************************/

#define WIDTH 128 /**< The width of the display in pixels */
#define HEIGHT 64 /**< The height of the display in pixels */
#define BLACK   0 /**< Color value for an unlit pixel for draw functions. */
#define WHITE   1 /**< Color value for a lit pixel for draw functions. */

static uint8_t sBuffer[(HEIGHT*WIDTH)/8] = {
0x00, 0x00, 0x00, 0x00, 0x00, 0x00, 0x00, 0x00, 0x00, 0x00, 0x00, 0x00, 0x00, 0x00, 0x00, 0x00,
0x00, 0x00, 0x00, 0x00, 0x00, 0x00, 0x00, 0x00, 0x00, 0x00, 0x00, 0x00, 0x00, 0x00, 0x00, 0x00,
0x00, 0x00, 0x00, 0x00, 0x00, 0x00, 0x00, 0x00, 0x00, 0x00, 0x00, 0x00, 0x00, 0x00, 0x00, 0x00,
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0x00, 0x00, 0x00, 0x00, 0x00, 0x00, 0x00, 0x00, 0x00, 0x00, 0x00, 0x00, 0x00, 0x00, 0x00, 0x00
};

volatile uint32_t & REG_DISPLAY = *reinterpret_cast<volatile uint32_t *>(0x02000000);

void setup() {
  REG_DISPLAY = 256; // VSYNC

  // Show initial display buffer contents --
  // initialized with an Adafruit splash screen.
  display();
  delay(2000);

  // Draw a single pixel in white
  clearDisplay();
  drawPixel(10, 10, WHITE);
  display();
  delay(2000);

  testdrawline();      // Draw many lines
  testdrawrect();      // Draw rectangles
  clearDisplay();
  display();
}

void loop() {}

void paintScreen(uint8_t image[])
{
  for (int16_t i = 0; i < WIDTH * HEIGHT / 8; i++)
  {
    REG_DISPLAY = image[i];
  }
}

void display()
{
  paintScreen(sBuffer);
}

void clearDisplay()
{
  for (int16_t i = 0; i < WIDTH * HEIGHT / 8; i++)
  {
     sBuffer[i] = BLACK;
  }
}

void drawPixel(int16_t x, int16_t y, uint8_t color)
{
  uint16_t row_offset;
  uint8_t bit;

  bit = 1 << (y & 7);
  row_offset = (y & 0xF8) * WIDTH / 8 + x;
  uint8_t data = sBuffer[row_offset] | bit;
  if (!color) data ^= bit;
  sBuffer[row_offset] = data;
}

void swap(int16_t& a, int16_t& b)
{
  int16_t temp = a;
  a = b;
  b = temp;
}

void drawLine(int16_t x0, int16_t y0, int16_t x1, int16_t y1, uint8_t color)
{
  // bresenham's algorithm - thx wikpedia
  bool steep = abs(y1 - y0) > abs(x1 - x0);
  if (steep) {
    swap(x0, y0);
    swap(x1, y1);
  }

  if (x0 > x1) {
    swap(x0, x1);
    swap(y0, y1);
  }

  int16_t dx, dy;
  dx = x1 - x0;
  dy = abs(y1 - y0);

  int16_t err = dx / 2;
  int8_t ystep;

  if (y0 < y1)
  {
    ystep = 1;
  }
  else
  {
    ystep = -1;
  }

  for (; x0 <= x1; x0++)
  {
    if (steep)
    {
      drawPixel(y0, x0, color);
    }
    else
    {
      drawPixel(x0, y0, color);
    }

    err -= dy;
    if (err < 0)
    {
      y0 += ystep;
      err += dx;
    }
  }
}

void testdrawline() {
  int16_t i;

  clearDisplay(); // Clear display buffer

  for(i=0; i<WIDTH; i+=4) {
    drawLine(0, 0, i, HEIGHT-1, WHITE);
    display(); // Update screen with each newly-drawn line
    delay(1);
  }
  for(i=0; i<HEIGHT; i+=4) {
    drawLine(0, 0, WIDTH-1, i, WHITE);
    display();
    delay(1);
  }
  delay(250);

  clearDisplay();

  for(i=0; i<WIDTH; i+=4) {
    drawLine(0, HEIGHT-1, i, 0, WHITE);
    display();
    delay(1);
  }
  for(i=HEIGHT-1; i>=0; i-=4) {
    drawLine(0, HEIGHT-1, WIDTH-1, i, WHITE);
    display();
    delay(1);
  }
  delay(250);

  clearDisplay();

  for(i=WIDTH-1; i>=0; i-=4) {
    drawLine(WIDTH-1, HEIGHT-1, i, 0, WHITE);
    display();
    delay(1);
  }
  for(i=HEIGHT-1; i>=0; i-=4) {
    drawLine(WIDTH-1, HEIGHT-1, 0, i, WHITE);
    display();
    delay(1);
  }
  delay(250);

  clearDisplay();

  for(i=0; i<HEIGHT; i+=4) {
    drawLine(WIDTH-1, 0, 0, i, WHITE);
    display();
    delay(1);
  }
  for(i=0; i<WIDTH; i+=4) {
    drawLine(WIDTH-1, 0, i, HEIGHT-1, WHITE);
    display();
    delay(1);
  }

  delay(2000); // Pause for 2 seconds
}

void testdrawrect() {
  clearDisplay();

  for(int16_t i=0; i<HEIGHT/2; i+=2) {
    drawRect(i, i, WIDTH-2*i, HEIGHT-2*i, WHITE);
    display(); // Update screen with each newly-drawn rectangle
    delay(1);
  }

  delay(2000);
}

void drawRect(int16_t x, int16_t y, uint8_t w, uint8_t h, uint8_t color)
{
  drawFastHLine(x, y, w, color);
  drawFastHLine(x, y+h-1, w, color);
  drawFastVLine(x, y, h, color);
  drawFastVLine(x+w-1, y, h, color);
}

void drawFastVLine(int16_t x, int16_t y, uint8_t h, uint8_t color)
{
  int end = y+h;
  for (int a = max(0,y); a < min(end,HEIGHT); a++)
  {
    drawPixel(x,a,color);
  }
}

void drawFastHLine(int16_t x, int16_t y, uint8_t w, uint8_t color)
{
  int16_t xEnd; // last x point + 1

  // Do y bounds checks
  if (y < 0 || y >= HEIGHT)
    return;

  xEnd = x + w;

  // Check if the entire line is not on the display
  if (xEnd <= 0 || x >= WIDTH)
    return;

  // Don't start before the left edge
  if (x < 0)
    x = 0;

  // Don't end past the right edge
  if (xEnd > WIDTH)
    xEnd = WIDTH;

  // calculate actual width (even if unchanged)
  w = xEnd - x;

  // buffer pointer plus row offset + x offset
  register uint8_t *pBuf = sBuffer + ((y / 8) * WIDTH) + x;

  // pixel mask
  register uint8_t mask = 1 << (y & 7);

  switch (color)
  {
    case WHITE:
      while (w--)
      {
        *pBuf++ |= mask;
      }
      break;

    case BLACK:
      mask = ~mask;
      while (w--)
      {
        *pBuf++ &= mask;
      }
      break;
  }
}
